## external_tree/package/helm/Config.in
```kconfig
config BR2_PACKAGE_HELM
	bool "helm"
	default y
	depends on BR2_x86_64
	depends on BR2_PACKAGE_HOST_GO_TARGET_ARCH_SUPPORTS
	depends on BR2_PACKAGE_HOST_GO_TARGET_CGO_LINKING_SUPPORTS
	help
	  Kubernetes package manager.
	  
	  https://helm.sh 
```

## src/package/energinet/kubernetes/Config.in
```kconfig
config BR2_PACKAGE_KUBERNETES
	bool "kubernetes"
	help
	  Includes kubernetes. <Explains what kubernetes is>

	  https://k8s.io
```
